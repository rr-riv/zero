#include <dt-bindings/zmk/matrix_transform.h>
#include "layouts.dtsi"

/ {
    chosen {
        zmk,physical-layout = &physical_layout0;
    };

    kscan0: kscan {
        compatible = "zmk,kscan-gpio-matrix";
        wakeup-source;
        diode-direction = "col2row";

        row-gpios =
            <&pro_micro 9 (GPIO_ACTIVE_HIGH | GPIO_PULL_DOWN)>,
            <&pro_micro 7 (GPIO_ACTIVE_HIGH | GPIO_PULL_DOWN)>,
            <&pro_micro 6 (GPIO_ACTIVE_HIGH | GPIO_PULL_DOWN)>,
            <&pro_micro 5 (GPIO_ACTIVE_HIGH | GPIO_PULL_DOWN)>;

        col-gpios =
            <&pro_micro 13 GPIO_ACTIVE_HIGH>,
            <&pro_micro 12 GPIO_ACTIVE_HIGH>,
            <&pro_micro 11 GPIO_ACTIVE_HIGH>,
            <&pro_micro 10 GPIO_ACTIVE_HIGH>,
            <&pro_micro 8 GPIO_ACTIVE_HIGH>;
    };
};

&physical_layout0 {
    kscan = <&kscan0>;
};
