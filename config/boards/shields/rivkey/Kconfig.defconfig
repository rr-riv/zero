## config/boards/shields/rivkey/Kconfig.defconfig
```kconfig
if SHIELD_RIVKEY_LEFT || SHIELD_RIVKEY_RIGHT

config ZMK_KEYBOARD_NAME
    default "rivkey"

config ZMK_SPLIT
    default y

config ZMK_SPLIT_ROLE_CENTRAL
    default y if SHIELD_RIVKEY_LEFT

endif
```

## config/boards/shields/rivkey/Kconfig.shield
```kconfig
config SHIELD_RIVKEY_LEFT
    def_bool $(shields_list_contains,rivkey_left)

config SHIELD_RIVKEY_RIGHT
    def_bool $(shields_list_contains,rivkey_right)
```
